## meta-xt-prod-aos-dom0/conf/layer.conf
```bitbake
# We have a conf and classes directory, add to BBPATH
BBPATH =. "${LAYERDIR}:"

# We have recipes-* directories, add to BBFILES
BBFILES += "${LAYERDIR}/recipes-*/*/*.bb \
            ${LAYERDIR}/recipes-*/*/*.bbappend"

BBFILE_COLLECTIONS += "meta-xt-prod-aos-dom0"
BBFILE_PATTERN_meta-xt-prod-aos-dom0 = "^${LAYERDIR}/"
BBFILE_PRIORITY_meta-xt-prod-aos-dom0 = "6"

LAYERSERIES_COMPAT_meta-xt-prod-aos-dom0 = "rocko sumo thud zeus"
```

## meta-xt-prod-aos-domf/conf/layer.conf
```bitbake
# We have a conf and classes directory, add to BBPATH
BBPATH =. "${LAYERDIR}:"

# We have recipes-* directories, add to BBFILES
BBFILES += "${LAYERDIR}/recipes-*/*/*.bb \
            ${LAYERDIR}/recipes-*/*/*.bbappend"

BBFILE_COLLECTIONS += "meta-xt-prod-aos-domf"
BBFILE_PATTERN_meta-xt-prod-aos-domf := "^${LAYERDIR}/"
BBFILE_PRIORITY_meta-xt-prod-aos-domf = "6"

LAYERSERIES_COMPAT_meta-xt-prod-aos-domf = "sumo thud zeus dunfell"
```

## meta-xt-prod-aos-driver-domain/conf/layer.conf
```bitbake
# We have a conf and classes directory, add to BBPATH
BBPATH =. "${LAYERDIR}:"

# We have recipes-* directories, add to BBFILES
BBFILES += "${LAYERDIR}/recipes-*/*/*.bb \
            ${LAYERDIR}/recipes-*/*/*.bbappend"

BBFILE_COLLECTIONS += "meta-xt-prod-aos-driver-domain"
BBFILE_PATTERN_meta-xt-prod-aos-driver-domain := "^${LAYERDIR}/"
BBFILE_PRIORITY_meta-xt-prod-aos-driver-domain = "6"

LAYERSERIES_COMPAT_meta-xt-prod-aos-driver-domain = "sumo thud dunfell"
```

## recipes-domu/domu-image-fusion/files/meta-xt-prod-extra/wic/core-image-minimal.wks
```
# short-description: Create an EFI disk image for Aos
# long-description: Creates a partitioned EFI disk image for Aos domain
part / --source rootfs --ondisk hda --fstype=ext4 --label platform --align 1024 --use-uuid
part /var/aos --ondisk hda --fstype=ext4 --label aos --align 1024 --size 512M --fsoptions="defaults,usrjquota=aquota.user,jqfmt=vfsv0"
```
